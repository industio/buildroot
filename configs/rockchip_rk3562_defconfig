## configs/rockchip_rk3562_defconfig
```kconfig
#include "base/base.config"
#include "base/common.config"
#include "chips/rk3562_aarch64.config"
#include "font/chinese.config"
#include "fs/exfat.config"
#include "fs/ntfs.config"
#include "fs/vfat.config"
#include "gpu/gpu.config"
#include "multimedia/audio.config"
#include "multimedia/camera.config"
#include "multimedia/gst/audio.config"
#include "multimedia/gst/camera.config"
#include "multimedia/gst/rtsp.config"
#include "multimedia/gst/video.config"
#include "multimedia/mpp.config"
#include "wifibt/bt.config"
#include "wifibt/wireless.config"
#include "tools/benchmark.config"
#include "tools/common.config"
#include "tools/test.config"
#include "network/chromium.config"
#include "npu2.config"
#include "powermanager.config"
#include "gui/weston.config"
#include "tools/gdb.config"
#include "bus/can.config"

BR2_PACKAGE_LINUX_TOOLS_PERF=y

#iperf3
BR2_PACKAGE_IPERF3=y
#vim
BR2_PACKAGE_VIM=y
#ffmpeg
BR2_PACKAGE_DIRECTFB=y
BR2_PACKAGE_SDL2_DIRECTFB=y
BR2_PACKAGE_SDL2_OPENGLES=y
BR2_PACKAGE_FFMPEG=y
BR2_PACKAGE_FFMPEG_FFPLAY=y
#iptables
BR2_PACKAGE_IPTABLES=y
#openssh
BR2_PACKAGE_OPENSSH=y
#localtime
BR2_TARGET_LOCALTIME="Asia/Shanghai"
#zip
BR2_PACKAGE_ZIP=y
BR2_PACKAGE_UNZIP=y
#dos2unix
BR2_PACKAGE_DOS2UNIX=y
#tree
BR2_PACKAGE_TREE=y
#mmc
BR2_PACKAGE_MMC_UTILS=y
#libgpiod
BR2_PACKAGE_LIBGPIOD=y
BR2_PACKAGE_LIBGPIOD_TOOLS=y
#fonts
BR2_PACKAGE_BITSTREAM_VERA=y
BR2_PACKAGE_CANTARELL=y
BR2_PACKAGE_GHOSTSCRIPT_FONTS=y
BR2_PACKAGE_INCONSOLATA=y
BR2_PACKAGE_NOTO_SANS_SC=y
#mqtt
BR2_PACKAGE_MOSQUITTO=y
BR2_PACKAGE_PAHO_MQTT_C=y
BR2_PACKAGE_PAHO_MQTT_CPP=y
#java
BR2_PACKAGE_XORG7=y
BR2_PACKAGE_OPENJDK=y
BR2_PACKAGE_OPENJDK_FULL_JDK=y
BR2_PACKAGE_OPENJDK_VERSION_11=y
#pcre2
BR2_PACKAGE_PCRE2=y
BR2_PACKAGE_PCRE2_16=y
BR2_PACKAGE_PCRE2_32=y

#qt5
BR2_PACKAGE_QT5=y
BR2_PACKAGE_QT53D=y
BR2_PACKAGE_QT5BASE_WIDGETS=y
BR2_PACKAGE_QT5BASE_FONTCONFIG=y
BR2_PACKAGE_QT5BASE_JPEG=y
BR2_PACKAGE_QT5BASE_PNG=y
BR2_PACKAGE_QT5BASE_TSLIB=y
BR2_PACKAGE_QT5QUICKCONTROLS=y
BR2_PACKAGE_QT5QUICKCONTROLS2=y
BR2_PACKAGE_QT5VIRTUALKEYBOARD=y
BR2_PACKAGE_QT5CHARTS=y
BR2_PACKAGE_QT5BASE_OPENGL_LIB=y
BR2_PACKAGE_QT5BASE_DEFAULT_QPA="wayland"
BR2_PACKAGE_QT5BASE_GIF=y
BR2_PACKAGE_QT5BASE_DBUS=y
BR2_PACKAGE_QT5MQTT=y
BR2_PACKAGE_QT5MULTIMEDIA=y
BR2_PACKAGE_QT5SCRIPT=y
BR2_PACKAGE_QT5SCXML=y
BR2_PACKAGE_QT5REMOTEOBJECTS=y
BR2_PACKAGE_QT5QUICKTIMELINE=y
BR2_PACKAGE_QT5OPCUA=y
BR2_PACKAGE_QT5LOTTIE=y
BR2_PACKAGE_QT5LOCATION=y
BR2_PACKAGE_QT5IMAGEFORMATS=y
BR2_PACKAGE_QT5GRAPHICALEFFECTS=y
BR2_PACKAGE_QT5ENGINIO=y
BR2_PACKAGE_QT5SENSORS=y
BR2_PACKAGE_QT5WAYLAND=y
BR2_PACKAGE_QT5WAYLAND_COMPOSITOR=y
BR2_PACKAGE_QT5VIRTUALKEYBOARD_ARROW_KEY_NAVIGATION=y
BR2_PACKAGE_QT5VIRTUALKEYBOARD_HANDWRITING=y
BR2_PACKAGE_QT5VIRTUALKEYBOARD_LANGUAGE_LAYOUTS="zh_CN"
BR2_PACKAGE_QT5SERIALBUS=y
BR2_PACKAGE_QT5SERIALPORT=y
BR2_PACKAGE_QT5BASE_MYSQL=y
BR2_PACKAGE_QT5WEBSOCKETS=y
# system test
BR2_PACKAGE_MEMTESTER=y
BR2_PACKAGE_ROCKCHIP_TEST=y
BR2_PACKAGE_RT_TESTS=y
BR2_PACKAGE_STRESS=y
BR2_PACKAGE_STRESS_NG=y
BR2_PACKAGE_STRESSAPPTEST=y

# tools
BR2_PACKAGE_COREUTILS=y
BR2_PACKAGE_EVTEST=y
BR2_PACKAGE_FILE=y
BR2_PACKAGE_I2C_TOOLS=y
BR2_PACKAGE_IPUTILS=y
BR2_PACKAGE_LRZSZ=y
BR2_PACKAGE_MOSQUITTO=y
BR2_PACKAGE_NETCAT=y
BR2_PACKAGE_STRACE=y
BR2_PACKAGE_TCPDUMP=y
BR2_PACKAGE_TRACEROUTE=y

# network
BR2_PACKAGE_DHCPCD=y
BR2_PACKAGE_DHCPDUMP=y
BR2_PACKAGE_DNSMASQ=y
# BR2_PACKAGE_DROPBEAR is not set
BR2_PACKAGE_GESFTPSERVER=y
BR2_PACKAGE_HOSTAPD=y
BR2_PACKAGE_NMAP=y
BR2_PACKAGE_NTP=y
BR2_PACKAGE_NTP_NTPDATE=y
BR2_PACKAGE_NTP_SNTP=y
BR2_PACKAGE_PPPD=y
BR2_PACKAGE_PPPD_FILTER=y
BR2_PACKAGE_PPPD_RADIUS=y
#bluez
BR2_PACKAGE_BLUEZ_TOOLS=y
#bridge
BR2_PACKAGE_BRIDGE_UTILS=y
```
